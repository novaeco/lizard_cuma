## Kconfig.projbuild
```kconfig
# Kconfig.projbuild - Options menuconfig custom pour projet
# Raisonnement : Permet config WIFI_SSID/PASS via interface (CI/CD friendly), au lieu de hardcode.
# Optimisation : Valeurs default ; sécurisé (PASS masqué).
# Intégration : Apparait dans idf.py menuconfig > Project Specific.

menu "Reptile Health Book Config"

config WIFI_SSID
    string "Wi-Fi SSID"
    default "VotreSSID"
    help
        SSID du réseau Wi-Fi (input via UI clavier aussi).

config WIFI_PASS
    string "Wi-Fi Password"
    default "VotrePass"
    help
        Mot de passe Wi-Fi (stocké NVS chiffré).

config REPTILE_DEBUG_LEVEL
    int "Debug Log Level"
    default 2  # INFO
    range 0 4  # 0=NONE, 4=TRACE
    help
        Niveau logs ESP_LOG (profiling perf.).

endmenu
```
